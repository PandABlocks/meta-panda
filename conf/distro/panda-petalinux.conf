## conf/distro/panda-petalinux.conf
```bitbake
require conf/distro/petalinux.conf

DISTRO = "panda-petalinux"
EXTRA_USERS_PARAMS = " \
    usermod -p '\$6\$GDH0YWFlK1NzdzN5\$DSxWmC2kvzup2kSlo5YET5.V0WpaUD/F/sSmNs7IMhzluXTKV5AGmHM/dB/Vs8kfVQcpIiutcCScv5yX1TNQV/' root; \
"
EXTRA_USERS_SUDOERS = ""
# Kernel related
KERNEL_IMAGETYPE = "uImage"
KERNEL_IMAGE_BIN_EXT = ""
# Initramfs related
INITRAMFS_IMAGE = "petalinux-initramfs-image"
INITRAMFS_IMAGE_BUNDLE = "1"
INITRAMFS_SCRIPTS = " \
    plnx-initramfs-framework-base \
    initramfs-pinit \
"
INITRAMFS_PACKAGES += "mtd-utils led-daemon e2fsprogs"
# Systemd related
INIT_MANAGER_DEFAULT = "systemd"
SYSTEMD_DEFAULT_TARGET = "multi-user.target"
VOLATILE_LOG_DIR = "no"
# Features
IMAGE_FEATURES += "package-management allow-root-login ssh-server-openssh"
PACKAGE_CLASSES = "package_ipk"
# Preferred providers
PREFERRED_PROVIDER_virtual/fsbl = "panda-fpga-boot"
PREFERRED_PROVIDER_virtual/boot-bin = "panda-fpga-boot"
PREFERRED_PROVIDER_virtual/bootloader = "panda-fpga-boot"
PREFERRED_PROVIDER_virtual/dtb = "panda-fpga-boot"
PREFERRED_PROVIDER_virtual/pmu-firmware = "panda-fpga-boot"
# Workaround for not picking the ROS provided sphinx recipe
PREFERRED_VERSION_python3-sphinx-native = "5.%"
```

## conf/layer.conf
```bitbake
# We have a conf and classes directory, add to BBPATH
BBPATH .= ":${LAYERDIR}"

# We have recipes-* directories, add to BBFILES
BBFILES += "${LAYERDIR}/recipes-*/*/*.bb \
            ${LAYERDIR}/recipes-*/*/*.bbappend"

BBFILE_COLLECTIONS += "meta-panda"
BBFILE_PATTERN_meta-panda = "^${LAYERDIR}/"
BBFILE_PRIORITY_meta-panda = "6"

LAYERDEPENDS_meta-panda = "core"
LAYERSERIES_COMPAT_meta-panda = "kirkstone langdale"
```
